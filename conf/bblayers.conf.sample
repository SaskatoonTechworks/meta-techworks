## conf/bblayers.conf.sample
```bitbake
# LAYER_CONF_VERSION is increased each time build/conf/bblayers.conf
# changes incompatibly
LCONF_VERSION = "5"

BBPATH = "${TOPDIR}"
BBFILES ?= ""

BBLAYERS ?= " \
  ##COREBASE##/meta \
  ##COREBASE##/meta-techworks \
  ##COREBASE##/meta-linaro/meta-linaro \
  ##COREBASE##/meta-linaro/meta-linaro-toolchain \
  ##COREBASE##/meta-oe/meta-oe \
  ##COREBASE##/meta-oe/meta-networking \
  ##COREBASE##/meta-oe/meta-webserver \
  "

BBLAYERS_NON_REMOVABLE ?= " \
  ##COREBASE##/meta \
  "
```

## conf/distro/include/techworks-providers.inc
```bitbake
#
# Default providers
#
PREFERRED_PROVIDER_jpeg ?= "jpeg"
PREFERRED_PROVIDER_jpeg-native ?= "jpeg-native"
PREFERRED_PROVIDER_zsh ?= "zsh-full"
```

## conf/distro/include/techworks-versions.inc
```bitbake
#
# Default preferred versions
#

# Use Linaro toolchain:
GCCVERSION ?= "linaro-4.8%"
```

## conf/distro/techworks-systemd.conf
```bitbake
include techworks.conf

TMPDIR .= "-systemd"

DISTRO_FEATURES_append = " systemd"
DISTRO_FEATURES_BACKFILL_CONSIDERED = "sysvinit"

VIRTUAL-RUNTIME_dev_manager = "udev"
VIRTUAL-RUNTIME_login_manager = "busybox"
VIRTUAL-RUNTIME_init_manager = "systemd"
VIRTUAL-RUNTIME_initscripts = "initscripts"
VIRTUAL-RUNTIME_keymaps = "keymaps"
```

## conf/distro/techworks.conf
```bitbake
include conf/distro/include/techworks-versions.inc
include conf/distro/include/techworks-providers.inc

DISTRO = "techworks"
DISTRO_NAME = "Saskatoon Techworks OpenEmbedded"
DISTRO_CODENAME = "mooseknuckle"
DISTRO_VERSION = "1.0"
#SDK_VERSION = "${DISTRO_VERSION}"
MAINTAINER = "Dan McGregor <dan.mcgregor@usask.ca>"
FILESYSTEM_PERMS_TABLES = "fs-perms-tw.txt"

# Blatently ripped off from Yocto:
CONNECTIVITY_CHECK_URIS ?= " \
             https://eula-downloads.yoctoproject.org/index.php \
             http://bugzilla.yoctoproject.org/report.cgi"

# Stripped down list that I've actually tested.
SANITY_TESTED_DISTROS ?= " \
            Poky-1.4 \n \
            Poky-1.4.1 \n \
            Ubuntu-12.04 \n \
            Ubuntu-12.10 \n \
            Ubuntu-13.04 \n \
            Fedora-18 \n \
            Fedora-19 \n \
            Debian-7.0 \n \
        "

# Default hash policy for distro
BB_SIGNATURE_HANDLER ?= 'OEBasicHash'

WARN_QA = "textrel pkgvarcheck"

TCLIBCAPPEND = "-${TCLIBC}"

include conf/distro/include/default-distrovars.inc

DISTRO_FEATURES = "vfat pam alsa argp ext2 largefile usbgadget usbhost xattr nfs zeroconf pci nfc x11 ${DISTRO_FEATURES_LIBC}"

# Distro can override the following VIRTUAL-RUNTIME providers:
VIRTUAL-RUNTIME_dev_manager = "udev"
VIRTUAL-RUNTIME_login_manager = "busybox"
VIRTUAL-RUNTIME_init_manager = "sysvinit"
VIRTUAL-RUNTIME_initscripts = "initscripts"
VIRTUAL-RUNTIME_keymaps = "keymaps"

# Language support:
GLIBC_GENERATE_LOCALES = "en_CA.UTF-8 en_GB.UTF-8 en_US.UTF-8"
IMAGE_LINGUAS ?= "en-gb en-ca"
LIMIT_BUILT_LOCALES ?= "POSIX en_GB en_CA en_US"

# We're Saskatoon Techworks -- Saskatoon, Saskatchewan, Canada
DEFAULT_TIMEZONE="Canada/Saskatchewan"
# Add techworks identifier to all images:
DISTRO_EXTRA_DEPENDS += " techworks-version"
```

## conf/layer.conf
```bitbake
# We have a conf and classes directory, add to BBPATH
BBPATH .= ":${LAYERDIR}"

# We have recipes-* directories, add to BBFILES
BBFILES += "${LAYERDIR}/recipes-*/*/*.bb \
            ${LAYERDIR}/recipes-*/*/*.bbappend"

BBFILE_COLLECTIONS += "techworks"
BBFILE_PATTERN_techworks = "^${LAYERDIR}/"
BBFILE_PRIORITY_techworks = "6"

TWBASE = '${@os.path.normpath("${LAYERDIR}/")}'
```
